## drivers/sip_svc/Kconfig
```kconfig
# Silicon vendor Provided Supervisory call driver for sip_svc subsystem

# Copyright (c) 2023 Intel Corporation
# SPDX-License-Identifier: Apache-2.0

menuconfig ARM_SIP_SVC_DRIVER
	bool "ARM SIP SVC driver"
	depends on ARM64
	help
	  ARM supervisory call driver for communicating with EL2 or EL3 firmware

if ARM_SIP_SVC_DRIVER

module = ARM_SIP_SVC_DRIVER
module-str = arm_sip_svc_driver
source "subsys/logging/Kconfig.template.log_config"

config ARM_SIP_SVC_DRIVER_INIT_PRIORITY
	int "Initialization priority"
	default 50

config ARM_SIP_SVC_HAS_DRIVER
	bool
	help
	   This is an option to be enabled by individual sip svc driver
	   to signal that there is a sip svc driver. This is used by other
	   modules which depends on sip svc driver.

config ARM_SIP_SVC_HAS_INTEL_SDM_MAILBOX_FIFO
	bool
	default y
	depends on DT_HAS_INTEL_AGILEX_SOCFPGA_SIP_SMC_ENABLED
	imply ARM_SIP_SVC_HAS_DRIVER
	help
	  Support for SDM mailbox fifo in Intel SoC FPGA Agilex via SMC calls

endif # ARM_SIP_SVC_DRIVER
```

## dts/bindings/sip_svc/intel,agilex-socfpga-sip-smc.yaml
```yaml
# Copyright (c) 2023 Intel Corporation
#
# SPDX-License-Identifier: Apache-2.0

description: SiP SVC driver instance on Intel Agilex SOC FPGA for SMC call

compatible: "intel,agilex-socfpga-sip-smc"

include: base.yaml

properties:
  method:
    type: string
    required: true
    description: The method of calling the EL3 or EL2 firmware
    enum:
      - smc
```
